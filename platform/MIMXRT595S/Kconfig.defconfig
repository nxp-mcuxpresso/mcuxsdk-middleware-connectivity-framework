## platform/MIMXRT595S/Kconfig.defconfig
```kconfig
# Copyright 2024 NXP
# All rights reserved.
# SPDX-License-Identifier: BSD-3-Clause

if MCUX_PRJSEG_middleware.wireless.framework.platform.MIMXRT595S

config MCUX_COMPONENT_middleware.wireless.framework.platform.lowpower
    select MCUX_COMPONENT_component.power_manager_framework
    select MCUX_COMPONENT_driver.lpc_rtc
    select MCUX_COMPONENT_driver.power

endif
```

## platform/kw47_mcxw72_nbu/Kconfig.defconfig
```kconfig
# Copyright 2025 NXP
#
# SPDX-License-Identifier: BSD-3-Clause

if MCUX_COMPONENT_middleware.wireless.framework.platform.kw47_mcxw72_nbu

config MCUX_COMPONENT_middleware.wireless.framework.platform.dbg
        select MCUX_COMPONENT_utility.assert

config MCUX_COMPONENT_middleware.wireless.framework.platform.dcdc

endif
```

## platform/wireless_nbu/Kconfig.defconfig
```kconfig
# Copyright 2024-2025 NXP
#
# SPDX-License-Identifier: BSD-3-Clause

if MCUX_PRJSEG_middleware.wireless.framework.platform.kw47_mcxw72_nbu

config MCUX_COMPONENT_middleware.wireless.framework.platform.ics
    select MCUX_COMPONENT_middleware.wireless.framework.function_lib
    select MCUX_COMPONENT_middleware.wireless.framework.sfc
    select MCUX_COMPONENT_middleware.wireless.framework.workq
    select MCUX_COMPONENT_component.lists
    select MCUX_COMPONENT_component.rpmsg_adapter

config MCUX_COMPONENT_middleware.wireless.framework.platform.ble
    select MCUX_COMPONENT_component.rpmsg_adapter

config MCUX_COMPONENT_middleware.wireless.framework.platform.lowpower
    select MCUX_COMPONENT_middleware.wireless.framework.sfc
    select MCUX_COMPONENT_middleware.wireless.framework.platform.dcdc

config MCUX_COMPONENT_middleware.wireless.framework.platform.rng
    select MCUX_COMPONENT_middleware.wireless.framework.platform.ics

endif

## KW43

if MCUX_PRJSEG_middleware.wireless.framework.platform.kw43_mcxw70_nbu

config MCUX_COMPONENT_middleware.wireless.framework.platform.ics
    select MCUX_COMPONENT_middleware.wireless.framework.function_lib
    select MCUX_COMPONENT_middleware.wireless.framework.sfc
    select MCUX_COMPONENT_component.rpmsg_adapter
    select MCUX_COMPONENT_component.wireless.framework.platform.sensors
    select MCUX_COMPONENT_middleware.wireless.framework.workq

config MCUX_COMPONENT_middleware.wireless.framework.platform.ble
    select MCUX_COMPONENT_component.rpmsg_adapter

config MCUX_COMPONENT_middleware.wireless.framework.platform.lowpower
    select MCUX_COMPONENT_middleware.wireless.framework.sfc

config MCUX_COMPONENT_middleware.wireless.framework.platform.rng
    select MCUX_COMPONENT_middleware.wireless.framework.platform.ics

endif
```

## services/DBG/Kconfig
```kconfig
# Copyright 2024-2025 NXP
# SPDX-License-Identifier: BSD-3-Clause

menu "Framework Debug"

rsource "sbtsnoop/Kconfig"
rsource "SWO/Kconfig"

config MCUX_COMPONENT_middleware.wireless.framework.dbg.fault_handlers
    bool "Fault Handlers for debug"
    select MCUX_COMPONENT_component.osa
    help
      Saves the various Fault Status and Address Registers to help decode
      cause of the fault.

if MCUX_COMPONENT_middleware.wireless.framework.dbg.fault_handlers

choice MCUX_COMPONENT_middleware.wireless.framework.dbg.fault_handlers.selection
    prompt "Fault handler selection APP / NBU Core"
    config MCUX_COMPONENT_middleware.wireless.framework.dbg.fault_handlers.nbu_core
        bool "Fault Handlers for NBU core"
        depends on  MCUX_PRJSEG_middleware.wireless.framework.platform.kw47_mcxw72_nbu || \
                    MCUX_PRJSEG_middleware.wireless.framework.platform.kw45_mcxw71_nbu || \
                    MCUX_PRJSEG_middleware.wireless.framework.platform.kw43_mcxw70_nbu
    config MCUX_COMPONENT_middleware.wireless.framework.dbg.fault_handlers.app_core
        bool "Fault Handlers for APP core"
        depends on  MCUX_PRJSEG_middleware.wireless.framework.platform.kw45_k32w1_mcxw71 || \
                    MCUX_PRJSEG_middleware.wireless.framework.platform.kw47_mcxw72 || \
                    MCUX_PRJSEG_middleware.wireless.framework.platform.kw43_mcxw70
        select MCUX_COMPONENT_utility.debug_console_lite
endchoice

config gDBG_LogInLinkLayerDebugStructEnabled_d
    bool "For NBU usage to Log coredump data in LL RAM"
    default y if MCUX_COMPONENT_middleware.wireless.framework.dbg.fault_handlers.nbu_core
    help
        No debug console is available on NBU core, this allows the data to be stored directly to RAM.
        No prefix in generated macro

endif

endmenu
```

## services/OTW/Kconfig
```kconfig
# Copyright 2024 NXP
# SPDX-License-Identifier: BSD-3-Clause

# OTW support configuration

menuconfig MCUX_COMPONENT_middleware.wireless.framework.otw
    bool "Over-The-Wire External Device Communication (OTW) for Matter"
    select MCUX_COMPONENT_component.gpio_adapter
    select MCUX_COMPONENT_component.crc_adapter
    select MCUX_COMPONENT_component.lpuart_adapter
    select MCUX_COMPONENT_component.osa_interface
    select MCUX_COMPONENT_utility.debug_console
    help
      Read/Write/Flash operation APIs to communicate Over The Wire with external transceiver.

if MCUX_COMPONENT_middleware.wireless.framework.otw

endif
```

## services/OtaSupport/Kconfig
```kconfig
# Copyright 2024 NXP
# SPDX-License-Identifier: BSD-3-Clause

menuconfig MCUX_COMPONENT_middleware.wireless.framework.ota_support
    bool "Over-The-Air Firmware update (OTA)"
    select MCUX_COMPONENT_component.osa_interface
    select MCUX_COMPONENT_component.messaging
    select MCUX_COMPONENT_component.flash_adapter
    select MCUX_COMPONENT_middleware.wireless.framework.function_lib
    select MCUX_COMPONENT_middleware.wireless.framework.platform.ota
    depends on MCUX_COMPONENT_middleware.wireless.framework.platform
    help
        Over-The-Air Firmware update APIs to store new OTA firmware chunks into the OTA flash region.

if MCUX_COMPONENT_middleware.wireless.framework.ota_support

    config MCUX_COMPONENT_middleware.wireless.framework.ota_support.external_flash
        bool "External flash"
        select MCUX_COMPONENT_middleware.wireless.framework.platform.external_flash
        help
            Use external flash for OTA Support.

    config MCUX_COMPONENT_middleware.wireless.framework.ota_support.internal_flash
        bool "Internal flash"
        select MCUX_COMPONENT_middleware.wireless.framework.platform.internal_flash
        help
            Use internal flash for OTA Support.
endif
```

## services/Sensors/Kconfig
```kconfig
# FModuleInfo configuration options

# Copyright 2024 NXP
# SPDX-License-Identifier: BSD-3-Clause

menuconfig MCUX_COMPONENT_middleware.wireless.framework.sensors
    bool "Sensors for Battery/Temperature measurements"
    select MCUX_COMPONENT_middleware.wireless.framework.platform.sensors
    select MCUX_COMPONENT_component.osa
    depends on MCUX_COMPONENT_middleware.wireless.framework.platform
    help
      Sensors APIs for Battery/Temperature measurements.

if MCUX_COMPONENT_middleware.wireless.framework.sensors

endif
```

## zephyr/port/settings/Kconfig
```kconfig
# Settings configuration options

# Copyright 2024 NXP
# SPDX-License-Identifier: BSD-3-Clause

config MCUX_COMPONENT_middleware.wireless.framework.zephyr_port.settings
    bool
    select MCUX_COMPONENT_component.osa_interface
    depends on MCUX_COMPONENT_middleware.wireless.framework.platform
    help
      This Component is a port of Zephyr Settings for connectivity Applications.

if MCUX_COMPONENT_middleware.wireless.framework.zephyr_port.settings

endif
```

## zephyr/subsys/fs/nvs/Kconfig
```kconfig
# Non-volatile Storage NVS

# Copyright 2024-2025 NXP
# Copyright (c) 2018 Laczen
# SPDX-License-Identifier: Apache-2.0

config NVS
	bool "Non-volatile Storage"
	select MCUX_COMPONENT_middleware.wireless.framework.zephyr_port.nvs
	select CRC
	help
	  Enable support of Non-volatile Storage.

if NVS

config NVS_LOOKUP_CACHE
	bool "Non-volatile Storage lookup cache"
	help
	  Enable Non-volatile Storage cache, used to reduce the NVS data lookup
	  time. Each cache entry holds an address of the most recent allocation
	  table entry (ATE) for all NVS IDs that fall into that cache position.

config NVS_LOOKUP_CACHE_SIZE
	int "Non-volatile Storage lookup cache size"
	default 128
	range 1 65536
	depends on NVS_LOOKUP_CACHE
	help
	  Number of entries in Non-volatile Storage lookup cache.
	  It is recommended that it be a power of 2.
config NVS_LOG_LEVEL
	default 0
	int "NVS log level"
	help
		0 no logs, 1 error, 2 warning, 3 info, 4 debug

endif
```
