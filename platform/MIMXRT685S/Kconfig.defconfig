## platform/MIMXRT685S/Kconfig.defconfig
```kconfig
# Copyright 2026 NXP
# SPDX-License-Identifier: BSD-3-Clause
if MCUX_COMPONENT_middleware.wireless.framework.platform.MIMXRT685S

config MCUX_COMPONENT_middleware.wireless.framework.platform.lowpower
    select MCUX_COMPONENT_component.power_manager_framework
    select MCUX_COMPONENT_driver.lpc_rtc
    select MCUX_COMPONENT_driver.power
    select MCUX_COMPONENT_component.ostimer_time_stamp_adapter

endif
```

## platform/kw43_mcxw70_nbu/Kconfig.defconfig
```kconfig
# Copyright 2026 NXP
#
# SPDX-License-Identifier: BSD-3-Clause

if MCUX_COMPONENT_middleware.wireless.framework.platform.kw43_mcxw70_nbu

config MCUX_COMPONENT_middleware.wireless.framework.platform.dbg
    select MCUX_COMPONENT_utility.assert

endif
```

## platform/rt1060/Kconfig.defconfig
```kconfig
# Copyright 2024-2026 NXP
# SPDX-License-Identifier: BSD-3-Clause

if MCUX_COMPONENT_middleware.wireless.framework.platform.rt1060

config MCUX_COMPONENT_middleware.wireless.framework.platform.external_flash
    select MCUX_COMPONENT_component.osa

config MCUX_COMPONENT_middleware.wireless.framework.platform.ota
    select MCUX_COMPONENT_middleware.wireless.framework.function_lib

endif # MCUX_COMPONENT_middleware.wireless.framework.platform.rt1060
```

## services/WorkQ/Kconfig
```kconfig
# Copyright 2025-2026 NXP
# SPDX-License-Identifier: BSD-3-Clause

menuconfig MCUX_COMPONENT_middleware.wireless.framework.workq
    bool "Simple workqueue threads"
    select MCUX_COMPONENT_component.osa
    select MCUX_COMPONENT_component.lists
    help
      Use workqueues to defer processing to shared threads.

if MCUX_COMPONENT_middleware.wireless.framework.workq
  menu "Work queue config"
      config FWK_SYSWORKQ_STACK_SIZE
          int "WorkQueue stack size"
          default 1700 if MCUX_COMPONENT_middleware.wireless.framework.seclib_rng_port.psa \
                          && MCUX_COMPONENT_utilities.gcov
          default 1500 if MCUX_COMPONENT_middleware.wireless.framework.seclib_rng_port.psa
          default 850  if MCUX_COMPONENT_utilities.gcov
          default 608
          help
              Macro to set work queue task stack size.
      config FWK_SYSWORKQ_PRIO
          int "WorkQueue task priority"
          default 14 if MCUX_COMPONENT_component.osa_bm
          default 4
          help
              Macro to set the system work queue task priority, usually set to a lower priority than other tasks.
              The priority value and logic depends on the OS: on BM (bare metal), higher numeric values mean lower priority.
              On FreeRTOS and ThreadX, lower numeric values mean lower priority.

  endmenu
endif
```
